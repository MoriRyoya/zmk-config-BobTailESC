## pmw3610/Kconfig
```kconfig
# Sensor data simulator
#
# Copyright (c) 2019 Nordic Semiconductor
#
# SPDX-License-Identifier: LicenseRef-Nordic-5-Clause
#

menuconfig PMW3610
	bool "PMW3610 mouse optical sensor"
	select SPI
	help
	  Enable PMW3610 mouse optical sensor.

if PMW3610

config PMW3610_SMART_ALGORITHM
	bool "Enable an algorithm of PMW3610 to enhance surface coverage"
	default y

config PMW3610_CPI
	int "PMW3610's default CPI"
	default 800
	range 200 3200

config PMW3610_CPI_DIVIDOR
	int "PMW3610's default CPI dividor"
	default 1
	range 1 100

config PMW3610_SNIPE_CPI
	int "PMW3610's CPI in snipe mode"
	default 200
	range 200 3200

config PMW3610_SNIPE_CPI_DIVIDOR
	int "PMW3610's CPI dividor in snipe mode"
	default 1
	range 1 100

config PMW3610_SCROLL_TICK
	int "PMW3610's required ticks to produce a scroll report"
	default 20

config PMW3610_SCROLL_LOCK_IDLE_MS
	int "Release scroll axis lock after this much idle time"
	default 150
	help
	  After the first dominant axis (vertical or horizontal) is chosen,
	  leftover motion on the other axis is ignored until the ball rests.

choice
	prompt "Select PMW3610's polling rate"
	default PMW3610_POLLING_RATE_250

config PMW3610_POLLING_RATE_250
	bool "250 Hz"

config PMW3610_POLLING_RATE_125
	bool "125 Hz"

config PMW3610_POLLING_RATE_125_SW
	bool "125 Hz with software implementation"

endchoice

config PMW3610_FORCE_AWAKE
	bool "PMW3610 forced awake mode"

config PMW3610_RUN_DOWNSHIFT_TIME_MS
	int "PMW3610's default RUN mode downshift time"
	default 128
	range 13 3264

config PMW3610_REST1_SAMPLE_TIME_MS
	int "PMW3610's sample time in REST1 stage"
	default 40
	range 10 2550

config PMW3610_REST1_DOWNSHIFT_TIME_MS
	int "PMW3610's default REST1 mode downshift time"
	default 9600

config PMW3610_REST2_SAMPLE_TIME_MS
	int "PMW3610's sample time in REST2 stage"
	default 0
	range 0 2550

config PMW3610_REST2_DOWNSHIFT_TIME_MS
	int "PMW3610's default REST2 mode downshift time"
	default 0

config PMW3610_REST3_SAMPLE_TIME_MS
	int "PMW3610's sample time in REST3 stage"
	default 0
	range 0 2550

choice
	prompt "Select PMW3610 sensor orientation"
	default PMW3610_ORIENTATION_0

config PMW3610_ORIENTATION_0
	bool "PMW3610 not rotated"

config PMW3610_ORIENTATION_90
	bool "PMW3610 rotated 90 deg clockwise"

config PMW3610_ORIENTATION_180
	bool "PMW3610 rotated 180 deg clockwise"

config PMW3610_ORIENTATION_270
	bool "PMW3610 rotated 270 deg clockwise"

endchoice

config PMW3610_INVERT_X
	bool "Invert the X axis of PMW3610 sensor"

config PMW3610_INVERT_Y
	bool "Invert the Y axis of PMW3610 sensor"

config PMW3610_INVERT_SCROLL_X
	bool "Invert the X axis of the scroll"
	default PMW3610_INVERT_X

config PMW3610_INVERT_SCROLL_Y
	bool "Invert the Y axis of the scroll"
	default PMW3610_INVERT_Y

config PMW3610_SCROLL_MOMENTUM
	bool "Keep scrolling briefly after the ball stops"
	help
	  macOS keeps a trackpad scroll coasting after the fingers lift. Without
	  this, the wheel stops the instant the ball does, which reads as abrupt
	  next to every other gesture on the machine.

	  When the ball comes to rest after a flick, the driver keeps emitting
	  wheel ticks on the axis that was already locked, slowing down until it
	  stops. Touching the ball again cancels the coast, so it never fights
	  the hand. Because the coast repeats the locked axis, it cannot produce
	  a stray HWHEEL tick.

if PMW3610_SCROLL_MOMENTUM

config PMW3610_SCROLL_MOMENTUM_SETTLE_MS
	int "Idle time that counts as the ball having stopped"
	default 70
	range 20 500
	help
	  Shorter feels more immediate but risks coasting during a slow drag.

config PMW3610_SCROLL_MOMENTUM_MIN_INTERVAL_MS
	int "Fastest coast interval in ms"
	default 16
	range 8 200
	help
	  Floor on the starting speed, so a very fast flick cannot flood the host.

config PMW3610_SCROLL_MOMENTUM_MAX_INTERVAL_MS
	int "Slowest coast interval in ms before the coast ends"
	default 100
	range 40 1000
	help
	  Also the cutoff for starting: a scroll slower than this was a deliberate
	  slow drag, not a flick, so it does not coast at all.

config PMW3610_SCROLL_MOMENTUM_DECAY_PERMILLE
	int "Per-tick slowdown, in permille of the current interval"
	default 1300
	range 1010 3000
	help
	  1300 stretches each gap by 30%. With the default interval range that is
	  roughly 7 coasted ticks over about 0.3 s -- enough to read as a trailing
	  edge, not enough to feel like the wheel is still spinning on its own.

config PMW3610_SCROLL_MOMENTUM_MIN_TICKS
	int "Ticks required in one flick before it may coast"
	default 5
	range 1 20
	help
	  A small nudge (a couple of ticks) should stop exactly where the hand
	  left it. Only a real flick -- enough ticks to show intent -- earns a
	  coast. Too low and every short scroll drags on past where the hand
	  stopped.

config PMW3610_SCROLL_MOMENTUM_MAX_TICKS
	int "Hard cap on coasted ticks"
	default 40
	range 1 500

endif # PMW3610_SCROLL_MOMENTUM

config PMW3610_AUTOMOUSE_TIMEOUT_MS
	int "Amount of milliseconds the mouse layer will be active after using the trackball"
	default 400

config PMW3610_MOVEMENT_THRESHOLD
	int "Movement threshold for automatic mouse layer activation"
	default 5

config PMW3610_BALL_ACTION_TICK
	int "PMW3610's required ticks to trigger a ball action"
	default 20

config PMW3610_BALL_ACTION_SETTLE_MS
	int "Delay after trackball motion settles before firing a ball action"
	default 80
	help
	  Gesture layer is on the left half, the ball is on the right. Key-up
	  arrives a BLE interval later, so pointing right after release would
	  otherwise still look like a flick. Wait until motion has settled,
	  and cancel if the gesture layer is gone.

module = PMW3610
module-str = PMW3610
source "${ZEPHYR_BASE}/subsys/logging/Kconfig.template.log_config"

endif #PMW3610
```
